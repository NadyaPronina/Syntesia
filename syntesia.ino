#include <Keypad.h>
const int sinus[1024] { 
            0x800,0x80d,0x819,0x826,0x832,0x83f,0x84b,0x858,0x865,0x871,
            0x87e,0x88a,0x897,0x8a3,0x8b0,0x8bc,0x8c9,0x8d5,0x8e2,0x8ee,
            0x8fb,0x907,0x914,0x920,0x92d,0x939,0x946,0x952,0x95e,0x96b,
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            0x7da,0x7e7,0x7f3,0x800
};

const int triang[1024]{
            0x8,0x10,0x18,0x20,0x28,0x30,0x38,0x40,0x48,0x50,
            0x58,0x60,0x68,0x70,0x78,0x80,0x88,0x90,0x98,0xa0,
            0xa8,0xb0,0xb8,0xc0,0xc8,0xd0,0xd8,0xe0,0xe8,0xf0,
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            0x18,0x10,0x8,0x0
};


const byte ROWS = 4; //four rows
const byte COLS = 4; //four columns

char hexaKeys[ROWS][COLS] = {
  {'1','2','3','A'},
  {'4','5','6','B'},
  {'7','8','9','C'},
  {'*','0','#','D'}
};

byte rowPins[ROWS] = {12, 11, 10, 9}; //connect to the row pinouts of the keypad
byte colPins[COLS] = {8, 7, 6, 5}; //connect to the column pinouts of the keypad
Keypad keypad = Keypad( makeKeymap(hexaKeys), rowPins, colPins, ROWS, COLS);

bool dur = false;
bool wave = false;

void generate(double coef){
  if (dur && !wave){
    for(int tmr = 0; tmr < 564*coef; ++tmr){             //быстрота (как долго звук звучит)
      for(int i = 0; i < 1024; i += 3*coef){               //зависимость от массива, частота звука (высота ноты)
        analogWrite(DAC1, sinus[i]); 
       }
     }
  }
  
  else if (!dur && !wave){
   for(int tmr = 0; tmr < 64*coef; ++tmr){             //быстрота (как долго звук звучит)
    for(int i = 0; i < 1024; i += 3*coef){               //зависимость от массива, частота звука (высота ноты)
      analogWrite(DAC1, sinus[i]);                      //если умножить на синус, то громче
    }
   }
  }
  
  else if (dur && wave){
    for(int tmr = 0; tmr < 564*coef; ++tmr){             //быстрота (как долго звук звучит)
    for(int i = 0; i < 1024; i += 3*coef){               //зависимость от массива, частота звука (высота ноты)
      analogWrite(DAC1, triang[i]); 
       }
     }
  }
  
  else if (!dur && wave){
   for(int tmr = 0; tmr < 64*coef; ++tmr){             //быстрота (как долго звук звучит)
    for(int i = 0; i < 1024; i += 3*coef){               //зависимость от массива, частота звука (высота ноты)
      analogWrite(DAC1, triang[i]);                      //если умножить на синус, то громче
    }
   }
  }
}

void setup(){
   analogWriteResolution(12);  // set the analog output resolution to 12 bit (4096 levels)

  analogReadResolution(12);
 pinMode (8, OUTPUT);
 pinMode (7, OUTPUT);
 pinMode (6, OUTPUT);
 pinMode (5, OUTPUT);
  
 pinMode (12, INPUT); 
 digitalWrite(12, HIGH);
 pinMode (11, INPUT);
 digitalWrite(11, HIGH);
 pinMode (10, INPUT);
 digitalWrite(10, HIGH);
 pinMode (9, INPUT);
 digitalWrite(9, HIGH);
 
 pinMode(DAC1, OUTPUT);
}

void loop(){
  char key = keypad.getKey();
  
  switch (key){
    default:
      break;
    case '1':
      generate(1);
      break;
    case '2':
      generate(2);
      break;
    case '3':
      generate(3);
      break;
    case '4':
      generate(4);
      break;
    case '5':
      generate(5);
      break;
    case '6':
      generate(6);
      break;
    case '7':
      generate(7);
      break;
    case '8':
      generate(8);
      break;
    case '9':
      generate(9);
      break;
    case '*':
      dur = !dur;
      break;
    case '#':
      wave = !wave;
      break;
  }
}
